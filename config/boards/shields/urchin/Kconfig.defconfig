## config/boards/shields/urchin/Kconfig.defconfig
```kconfig
# Copyright (c) 2022 Duccio Breschi
# SPDX-License-Identifier: MIT

if SHIELD_URCHIN_LEFT

config ZMK_KEYBOARD_NAME
    default "urchin"

config ZMK_SPLIT_ROLE_CENTRAL
    default y

config BT_SMP_SC_PAIR_ONLY
    default n

config BT_SMP_SC_ONLY
    default n

endif

if SHIELD_URCHIN_LEFT || SHIELD_URCHIN_RIGHT
config ZMK_SPLIT
    default y
endif
```
